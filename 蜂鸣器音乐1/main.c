#include <reg51.h>
#define uint unsigned int
#define uchar unsigned char
sbit beep = P2^5;
sbit happy = P3^1;
sbit sa = P3^0;
sbit LSA=P2^2;
sbit LSB=P2^3;
sbit LSC=P2^4;
#define SMG P0
unsigned char num_code[18]={0x00,0x3f,0x06,0x5b,0x4f,0x66,0x6d,0x7d,0x07,0x7f,0x6f,0x77,0x7c,0x39,0x5e,0x79,0x71};
uchar code happybirthday_SONG_TONE[]={212,212,190,212,159,169,212,212,190,212,142,159,
212,212,106,126,159,169,190,119,119,126,159,142,159,0};

uchar code happybirthday_SONG_LONG[]={9,3,12,12,12,24,9,3,12,12,12,24,
9,3,12,12,12,12,12,9,3,12,12,12,24,0};

//延时
void DelayMS(uint x)
{
uchar t;
while(x--) for(t=0;t<120;t++);
}

void PlayMusic()
{
uint i=0,j,k;
while(happybirthday_SONG_LONG[i]!=0||happybirthday_SONG_TONE[i]!=0)
{ //播放各个音符，SONG_LONG 为拍子长度
    for(j=0;j<happybirthday_SONG_LONG[i]*20;j++)
{
    beep=~beep;
//SONG_TONE 延时表决定了每个音符的频率
    for(k=0;k<happybirthday_SONG_TONE[i]/3;k++);
}
    DelayMS(10);
    i++;
}
}
void happybirthday()
{
	PlayMusic(); //播放生日快乐
DelayMS(500); //播放完后暂停一段时间
}
/*祝你平安*/  
/*******************************************/

unsigned char Count;
sbit _Speak =P2^5 ;
unsigned char code SONG[] ={      //祝你平安
0x26,0x20,0x20,0x20,0x20,0x20,0x26,0x10,0x20,0x10,0x20,0x80,0x26,0x20,0x30,0x20,
0x30,0x20,0x39,0x10,0x30,0x10,0x30,0x80,0x26,0x20,0x20,0x20,0x20,0x20,0x1c,0x20,
0x20,0x80,0x2b,0x20,0x26,0x20,0x20,0x20,0x2b,0x10,0x26,0x10,0x2b,0x80,0x26,0x20,
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0x20,0x10,0x2b,0x10,0x26,0x30,0x30,0x80,0x00};

void Time0_Init()
{
 TMOD = 0x01;
 IE   = 0x82;
 TH0  = 0xD8;
 TL0  = 0xEF;  //12MZ晶振，10ms
}

void Time0_Int() interrupt 1
{
 TH0 = 0xD8;
 TL0 = 0xEF;
 Count++;   //长度加1
}

/*-------------------------------------------------
功能:1MS延时子程序
-------------------------------------------------*/
void Delay_xMs(unsigned int x)
{
    unsigned int i,j;
    for( i =0;i < x;i++ )
    {
        for( j =0;j<3;j++ );
    }
}

void safe(unsigned char i)
{
 unsigned char Temp1,Temp2;
 unsigned int Addr;
 Count = 0;      //中断计数器清0
 Addr = i * 217;
 while(1)
 {
  Temp1 = SONG[Addr++];
     if ( Temp1 == 0xFF )          //休止符
     {
      TR0 = 0;
      Delay_xMs(100);
     }
     else if ( Temp1 == 0x00 )   //歌曲结束符
     {
      return;
     }
     else
     {
      Temp2 = SONG[Addr++];
      TR0 = 1;
     while(1)
     {
       _Speak = ~_Speak;
       Delay_xMs(Temp1);
       if ( Temp2 == Count )
       {
        Count = 0;
        break;
       }
      }
     }
 }
}
void smg_switch(int x)//位选到第x个数码管
{
	x=8-x;
	LSA=x%2;
	x=x/2;
	LSB=x%2;
	x=x/2;
	LSC=x%2;
}
void main()
{
	Time0_Init();   //定时器0中断初始化

	smg_switch(1);
	SMG=num_code[0];

 while(1)
 {
	if(happy==0)
	{	
		SMG=num_code[1+1];
		happybirthday();
		SMG=num_code[0];
	}
	if(sa==0)
	{
		SMG=num_code[2+1];
		EA=1;
		safe();
		EA=0;
		SMG=num_code[0];	
	}
 }
}